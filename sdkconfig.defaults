## sdkconfig.defaults
```kconfig
# Enable PSRAM (8MB external RAM on ESP32-S3R8)
CONFIG_SPIRAM=y
CONFIG_SPIRAM_MODE_OCT=y
CONFIG_SPIRAM_SPEED_80M=y
CONFIG_SPIRAM_USE_MALLOC=y
CONFIG_SPIRAM_MALLOC_ALWAYSINTERNAL=8192

# Bluetooth Configuration
CONFIG_BT_ENABLED=y
CONFIG_BT_BLUEDROID_ENABLED=y
CONFIG_BT_BLE_ENABLED=y

# Use PSRAM for BLE to prevent stack overflow
CONFIG_BT_BLE_DYNAMIC_ENV_MEMORY=y
CONFIG_BT_ALLOCATION_FROM_SPIRAM_FIRST=y
CONFIG_BTDM_CTRL_BLE_MAX_CONN=1
CONFIG_BT_NIMBLE_MAX_CONNECTIONS=1

# Increase task stack sizes
CONFIG_ESP_MAIN_TASK_STACK_SIZE=8192
CONFIG_ARDUINO_LOOP_STACK_SIZE=16384
CONFIG_ESP_SYSTEM_EVENT_TASK_STACK_SIZE=4096

# Increase BT controller DRAM
CONFIG_BT_RESERVE_DRAM=0x10000
```
